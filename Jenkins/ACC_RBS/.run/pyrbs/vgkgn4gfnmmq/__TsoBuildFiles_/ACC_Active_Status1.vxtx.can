/* !Encoding: 65001  */
includes
{
  #include "__VariablesLib.cin"
  #include "__CaplGeneratorLib.cin"
  #include "__CANoeReportFuntionsLib.cin"
}

variables
{
  // Global variables defined within this CAPL file
}

void Ttpbeahau_Tet_TtInit()
{

}

void Ttpbeahau_Tet_Tc0()
{
  CreateTTEIFFunction("Ttpbeahau_Tc0", __eTcDef, __eLocal);  
  CallInterfaceFunction("Check ACC Active Status", __cEmpty , __cEmpty );
}
testcase Ttpbeahau_Tc0()
{	
  SetBreakOnFail(1);

  TestCommandBegin(__eSet, __cSet, "", "0");
  {
  
    __ReportTableHead3Columns(__cSetCaption , __cTSym, __cTOp, __cAssigned); 
    {
      $`CAN::dbNode::`GWM::`MO_Message_1::`MO_sig_ReadytoDrive.phys = 2;
      __ReportSignalSetLValue("CAN signal 'MO_sig_ReadytoDrive'", `CAN::dbNode::`GWM::`MO_Message_1::`MO_sig_ReadytoDrive, __cArray);
      __ReportTableRow(0, __cArray, __cAOp, 2, "");
    }
    __ReportTableEndTestStep("1");
  }
  TestCommandEnd();

  TestCommandBegin(__eSet, __cSet, "", "1");
  {
  
    __ReportTableHead3Columns(__cSetCaption , __cTSym, __cTOp, __cAssigned); 
    {
      $`CAN::dbNode::`BCM::`ACC_BCM_Message::`ACC_Int_status.phys = 1;
      __ReportSignalSetLValue("CAN signal 'ACC_Int_status'", `CAN::dbNode::`BCM::`ACC_BCM_Message::`ACC_Int_status, __cArray);
      __ReportTableRow(0, __cArray, __cAOp, 1, "");
    }
    __ReportTableEndTestStep("1");
  }
  TestCommandEnd();

  TestCommandBegin(__eSet, __cSet, "", "2");
  {
  
    __ReportTableHead3Columns(__cSetCaption , __cTSym, __cTOp, __cAssigned); 
    {
      $`CAN::dbNode::`BCM::`ACC_BCM_Message::`ACC_MainSwitch_ACC.phys = 2;
      __ReportSignalSetLValue("CAN signal 'ACC_MainSwitch_ACC'", `CAN::dbNode::`BCM::`ACC_BCM_Message::`ACC_MainSwitch_ACC, __cArray);
      __ReportTableRow(0, __cArray, __cAOp, 2, "");
    }
    __ReportTableEndTestStep("1");
  }
  TestCommandEnd();

  TestCommandBegin(__eSet, __cSet, "", "3");
  {
  
    __ReportTableHead3Columns(__cSetCaption , __cTSym, __cTOp, __cAssigned); 
    {
      $`CAN::dbNode::`GWM::`Gear_Message::`Gear_signal.phys = 3;
      __ReportSignalSetLValue("CAN signal 'Gear_signal'", `CAN::dbNode::`GWM::`Gear_Message::`Gear_signal, __cArray);
      __ReportTableRow(0, __cArray, __cAOp, 3, "");
    }
    __ReportTableEndTestStep("1");
  }
  TestCommandEnd();

  TestCommandBegin(__eSet, __cSet, "", "4");
  {
  
    __ReportTableHead3Columns(__cSetCaption , __cTSym, __cTOp, __cAssigned); 
    {
      $`CAN::dbNode::`BCM::`RDS_Coder_Data_CAN::`Sig_Spdmtr_Rq.phys = 70;
      __ReportSignalSetLValue("CAN signal 'Sig_Spdmtr_Rq'", `CAN::dbNode::`BCM::`RDS_Coder_Data_CAN::`Sig_Spdmtr_Rq, __cArray);
      __ReportTableRow(0, __cArray, __cAOp, 70, "");
    }
    __ReportTableEndTestStep("1");
  }
  TestCommandEnd();

  TestCommandBegin(__eSet, __cSet, "", "5");
  {
  
    __ReportTableHead3Columns(__cSetCaption , __cTSym, __cTOp, __cAssigned); 
    {
      $`CAN::dbNode::`BCM::`ACC_BCM_Message::`ACC_Set_signal.phys = 1;
      __ReportSignalSetLValue("CAN signal 'ACC_Set_signal'", `CAN::dbNode::`BCM::`ACC_BCM_Message::`ACC_Set_signal, __cArray);
      __ReportTableRow(0, __cArray, __cAOp, 1, "");
    }
    __ReportTableEndTestStep("1");
  }
  TestCommandEnd();

  TestCommandBegin(__eWait, __cWait, "", "6");
  {
    __Wait("1", (500 * 1000000), 1000000, "");
  }
  TestCommandEnd();

  TestCommandBegin(__eCheck, __cCheck, "", "7");
  {
    __bVerdict = __eVerdictPass;
    __ReportTableHead5Columns(__cCheckCaption, __cTSym, __cTOp, __cRefVal, __cActual, __cRes);
    {
      __csr = CheckSignalMatch(`CAN::`ACC_status::`ACC_sig_status, 2, "==") == 1;
      __ReportTableRow(0, "CAN signal 'ACC_sig_status'", "==", 2, "");
      __ReportCell(`CAN::`ACC_status::`ACC_sig_status);
      __ReportCellResult(__csr, __ePassFail);
      __bVerdict = __bVerdict && __csr;
    }
    __ReportTableEndVerdict("1", __bVerdict);
  }
  TestCommandEnd();

}

